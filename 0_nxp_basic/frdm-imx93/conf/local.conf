## 0_nxp_basic/frdm-imx93/conf/local.conf
```bitbake
MACHINE ??= 'imx93frdm'
DISTRO ?= 'fsl-imx-xwayland'
EXTRA_IMAGE_FEATURES ?= "debug-tweaks"
USER_CLASSES ?= "buildstats"
PATCHRESOLVE = "noop"
BB_DISKMON_DIRS ??= "\
    STOPTASKS,${TMPDIR},1G,100K \
    STOPTASKS,${DL_DIR},1G,100K \
    STOPTASKS,${SSTATE_DIR},1G,100K \
    STOPTASKS,/tmp,100M,100K \
    HALT,${TMPDIR},100M,1K \
    HALT,${DL_DIR},100M,1K \
    HALT,${SSTATE_DIR},100M,1K \
    HALT,/tmp,10M,1K"
PACKAGECONFIG:append:pn-qemu-system-native = " sdl"
CONF_VERSION = "2"

DL_DIR ?= "${BSPDIR}/downloads/"
ACCEPT_FSL_EULA = "1"

# Switch to Debian packaging and include package-management in the image
PACKAGE_CLASSES = "package_deb"
EXTRA_IMAGE_FEATURES += "package-management"

# Remove work directories after build to save space
INHERIT += "rm_work"

# --- 8 GB VM limits ---
BB_NUMBER_THREADS = "3"
PARALLEL_MAKE = "-j 3"
BB_PRESSURE_MAX_MEMORY = "10000"
BB_PRESSURE_MAX_IO = "15000"
PARALLEL_MAKE:pn-qtbase = "-j 2"
PARALLEL_MAKE:pn-qtdeclarative = "-j 2"
PARALLEL_MAKE:pn-qtwebengine = "-j 1"
PARALLEL_MAKE:pn-tensorflow-lite = "-j 2"
PARALLEL_MAKE:pn-onnxruntime = "-j 2"
PTEST_ENABLED:pn-qtbase = "0"

# --- disk space ---
RM_WORK_EXCLUDE += "linux-imx u-boot-imx"
IMAGE_FSTYPES = "wic.zst"
PACKAGE_DEBUG_SPLIT_STYLE = "debug-without-src"
BB_DISKMON_DIRS = "\
    STOPTASKS,${TMPDIR},5G,100K \
    STOPTASKS,${DL_DIR},2G,100K \
    STOPTASKS,${SSTATE_DIR},2G,100K \
    STOPTASKS,/tmp,100M,100K \
    HALT,${TMPDIR},1G,10K \
    HALT,${DL_DIR},500M,10K \
    HALT,${SSTATE_DIR},500M,10K \
    HALT,/tmp,10M,1K"
```

## 0_nxp_basic/sources/meta-local/conf/layer.conf
```bitbake
BBPATH .= ":${LAYERDIR}"
BBFILES += "${LAYERDIR}/recipes-*/*/*.bb ${LAYERDIR}/recipes-*/*/*.bbappend"
BBFILE_COLLECTIONS += "local"
BBFILE_PATTERN_local = "^${LAYERDIR}/"
BBFILE_PRIORITY_local = "99"
LAYERSERIES_COMPAT_local = "scarthgap"
```
